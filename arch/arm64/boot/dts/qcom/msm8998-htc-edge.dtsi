&pm8998_gpios {
	v_eg_3v_en { /* GPIO 2 - V_EG_3V_EN */
		v_eg_3v_en_default: v_eg_3v_en_default {
			pins = "gpio2";
			function = "normal";
			output-high;
			drive-push-pull;
			bias-disable;
			qcom,drive-strength = <PMIC_GPIO_STRENGTH_LOW>;
		};
	};
};

